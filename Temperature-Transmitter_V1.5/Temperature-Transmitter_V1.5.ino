////////////////////////////////////////////////////////////////////////////////////////////////
//                                                                                            //
//               КУХОННЫЕ ЧАСЫ С ТЕРМОМЕТРОМ (KITCHEN CLOCK WITH THERMOMETER)                 //
//               РАДИОПЕРЕДАТЧИК ТЕМПЕРАТУРЫ  (Radio Transmitter Temperature)                 //
//                    Отдельный модуль трансляции температуры для часов                       //
//                                    Версия (Version) 1.5                                    //
//                   Код от Анатолия Невзорова (Сode by Anatoly Nevzoroff)                    //
//                            https://github.com/AnatolyNevzoroff                             //
//                                                                                            //
////////////////////////////////////////////////////////////////////////////////////////////////

////////////////////////////////////////////////////////////////////////////////////////////////
//  СОСТАВ ОБОРУДОВАНИЯ:
//  ARDUINO NANO (AVR ATmega328P либо LGT8F328P)
//  ДАТЧИК ТЕМПЕРАТУРЫ Dallas Semiconductor DS18B20 (-55°C...+125°C)
//  ПЕРЕДАТЧИК SYN115 либо WL102-341(433,92 МГц)(2,0В...3,6В)
//  СТАБИЛИЗАТОР НАПРЯЖЕНИЯ AMS1117 (3,3В)
////////////////////////////////////////////////////////////////////////////////////////////////

////////////////////////////////////////////////////////////////////////////////////////////////
// НА ПЛАТЕ ARDUINO NANO (ATmega328P) ЗАДЕЙСТВОВАНЫ СЛЕДУЮЩИЕ ВЫВОДЫ:
//            ADC GPIO  A0  <<-> 
//            ADC GPIO  A1  <<-> 
//            ADC GPIO  A2  <<-> 
//            ADC GPIO  A3  <<-> 
//        SDA ADC GPIO  A4  <<-> 
//        SCL ADC GPIO  A5  <<-> 
//            ADC       A6  <<- 
//            ADC       A7  <<- 
//       INT0     GPIO  D2  <-> 
// TMR2b INT1 PWM GPIO  D3  <->> 
//                GPIO  D4  <->  DAT SYN115 либо WL102-341
// TMR0b      PWM GPIO  D5  <->> INPUT DS18B20
// TMR0a      PWM GPIO  D6  <->> 
//                GPIO  D7  <->  
//                GPIO  D8  <->  
// TMR1a      PWM GPIO  D9  <->> 
// TMR1b      PWM GPIO  D10 <->> 
// TMR2a MOSO PWM GPIO  D11 <->> 
//       MISO     GPIO  D12 <->  
//       SCLK     GPIO  D13 <->  LED FEEDBACK (AND INTEGRATED IN BOARD)
/////////////////////////////////////////////////////////////////////////////////////////////////


//ПОДКЛЮЧАЕМЫЕ БИБЛИОТЕКИ:
//Если ссылка на библиотеку отсутствует, значит она входит в стандартный набор Аrduino IDE
//Для дополнительных библиотек указанны ссылки-первоисточники 
//С данным файлом выложены архивы библиотек в версиях на момент компиляции

#include <SPI.h>//Не используется, но необходима для компиляции
#include <OneWire.h>// https://github.com/milesburton/Arduino-Temperature-Control-Library 
#include <RH_ASK.h>// http://www.airspayce.com/mikem/arduino/RadioHead/
/////////////////////////////////////////////////////////////////////////////////////////////////

//ДЛЯ ПРОВЕРКИ ДАТЧИКА ВЫВОДИМ ЗНАЧЕНИЯ ТЕМПЕРАТУРЫ В МОНИТОР СЕРИЙНОГО ПОРТА 
// #define LOG_ENABLE //В РАБОЧЕЙ ВЕРСИИ УДАЛИТЬ ИЛИ ЗАКОММЕНТИРОВАТЬ!

/////////////////////////////////////////////////////////////////////////////////////////////////
#define DS18B20_PIN 5 //D5 Вход для термодатчика DS18B20 
#define Transmitter_PIN 4 //D4 Выход для передатчика SYN115 либо WL102-341
#define LED_INFO_PIN 13 //Встроенный светодиод для индикации активности
#define Speed_TX 1200 //Скорость передачи



//ОБЪЯВЛЯЕМ ОБЪЕКТ "ds", ДЛЯ ЧТЕНИЯ ТЕМПЕРАТУРЫ С ДАТЧИКА DS18B20
OneWire ds(DS18B20_PIN);

//УСТАНАВЛИВАЕМ СКОРОСТЬ ПЕРЕДАЧИ И ВЫВОД ДЛЯ ПОДКЛЮЧЕНИЯ ПЕРЕДАТЧИКА 
//Можно создать объект "driver" командой: "RH_ASK driver" без параметров
//библиотека назначит скорость и выводы по умолчанию, фактически это команда: 
//RH_ASK driver(2400,11,12,10)
//Но лучше задать параметры самостоятельно: RH_ASK driver(Speed,RX pin,TX pin,Ptt pin)
//Speed -> Скорость приёма или передачи (бит/с), 
//RX pin -> Вывод подключения Приёмника, 
//TX pin -> Вывод подключения Передачика, 
//Ptt pin -> Вывод для переключения между режимами приёма и передачи (Push to Talk)
//Push to Talk в применяемых модулях отсутствует, в итоге:
RH_ASK driver(Speed_TX,-1,Transmitter_PIN,-1);



////////////////////////////////////////////////////////////////////////////////////////////////
//unsigned long от 0 до 4294967295
uint32_t MAIN_timer,Timer_LED;//Таймеры для функции "millis()"


//float от -3.4028235E+38 до 3.4028235E+38
float celsius;//Температура в градусах Цельсия с точностью до шести сотых (0,06)
float TempC;//Температура в градусах Цельсия с точностью до десятых (0,0) 
//Если добавить в состав оборудования например, датчик влажности, при наличии библиотеки 
//можно передавать больше данных, но в данном скетче строки закомментированы
//float humidity;//Влажность с точностью до десятых %


//int от -32768 до 32767
int16_t tmpr,temp;//Значения температуры
//int16_t hum;//Значения влажности


//char от -128 до 127
char msg[8];//Массив для передачи данных (При наличии влажности msg[12])


//byte от 0 до 255 (1 byte)
//uint8_t flag=false;
//byte addr[8];//Массив для адреса датчика





////////////////////////////////////////////////////////////////////////////////////////////////
//                                          S E T U P                                         //
////////////////////////////////////////////////////////////////////////////////////////////////

void setup(){

#ifdef LOG_ENABLE
Serial.begin(9600);
#endif

//ds.reset();//Инициализация датчика температуры совместно со сбросом шины данных
//ds.write(0xCC);//Сброс поиска датчика по адресу или ds.select(addr);
//ds.write(0x44);//Запрос на измерение и рассчёт температуры 
//if(!ds.search(addr)){ds.reset_search();delay(250);return;}

driver.init();//Инициализация передатчика

pinMode(LED_INFO_PIN,OUTPUT);//Выход для светодиода
digitalWrite(LED_INFO_PIN,LOW);//Гасим светодиод

MAIN_timer=millis();

}//END SEТUP




/////////////////////////////////////////////////////////////////////////////////////////////////
//                                           L O O P                                           //
/////////////////////////////////////////////////////////////////////////////////////////////////

void loop(){

//Каждые 3 секунды запрашиваем температуру и передаём по радиоканалу, можно чаще, но датчик, 
//вычисляя температуру, слегка греется и может завышать показания при более частых запросах
if(millis()-MAIN_timer>3000){MAIN_timer=millis();

Temperature();//Получаем температуру с датчика

//ПЕРЕВОДИМ ТЕМПЕРАТУРУ ОКРУГЛЁННУЮ ДО ДЕСЯТЫХ В ЦЕЛОЕ ПОЛОЖИТЕЛЬНОЕ ЧИСЛО ИЗ 4-Х РАЗРЯДОВ
//Диапазон температур измеряемый датчиком составляет: от -55,00 °C до +125,00 °C
//Для перевода температуры округлённой до десятых в целое положительное число умножаем на 10
//Диапазон значений составит: от -550 до +1250 
//Для передачи температуры переводим весь диапазон в положительную область, прибавив 1000 
//Диапазон значений составит: от +450 до +2250  

tmpr=TempC*10+1000;

//Переводим влажность с десятыми в целое положительное число из 4-х разрядов
//hum=humidity*10+1000; 

//ФОРМИРУЕМ ПАКЕТ ДАННЫХ ДЛЯ ПЕРЕДАЧИ
String strMsg="TX1";//Сигнатура-идентификатор конкретного датчика (3 любых символа)
strMsg+=tmpr;//Добавляем в строку "strMsg" температуру (4 знака)
//strMsg+=hum;//Можно дополнительно добавить в строку, например, влажность (4 знака)
strMsg.toCharArray(msg,8);//Переводим String строку из 3+4+1=8 знаков в массив "msg" 

//ЗАГРУЖАЕМ МАССИВ В ПЕРЕДАТЧИК И ОТПРАВЛЯЕМ
driver.send((uint8_t *)msg, strlen(msg));
driver.waitPacketSent();//Ждём полного окончания передачи

//Для контроля работоспособности датчика выводим значения в монитор серийного порта
#ifdef LOG_ENABLE
Serial.print(F("Температура С ДАТЧИКА: "));Serial.println(temp);
Serial.print(F("Температура ДО СОТЫХ: "));Serial.println(celsius);
Serial.print(F("Температура ДО ДЕСЯТЫХ: "));Serial.println(TempC,1);
Serial.println();
int term=TempC*10;
int whole=term/10;//Делим на 10, и получаем целое число, int отбросит дробь
int fract=term%10;//Остаток от деления на 10 будет дробной частью
Serial.print(F("ИТОГОВОЕ ЗНАЧЕНИЕ: "));//Печатаем температуру в привычном виде
if(temp<0){Serial.print('-');}else{Serial.print('+');}
Serial.print(whole);Serial.print(',');Serial.println(fract);
Serial.println();
Serial.print(F("Температура ДЛЯ ПЕРЕДАЧИ: "));Serial.println(tmpr);
Serial.print(F("ПОЛНЫЙ ПЕКЕТ ДЛЯ ПЕРЕДАЧИ: "));Serial.println(msg);
Serial.println();Serial.println();
#endif


Timer_LED=millis();digitalWrite(LED_INFO_PIN,HIGH);//Зажигаем светодиод
}//Конец цикла получения температуры и передачи данных каждые 3 сек.


if(millis()-Timer_LED>200){digitalWrite(LED_INFO_PIN,LOW);}//Гасим светодиод через 0,2 сек.


}//END LOOP


/////////////////////////////////////////////////////////////////////////////////////////////////
//                                             END                                             //
/////////////////////////////////////////////////////////////////////////////////////////////////
